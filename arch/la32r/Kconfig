## arch/la32r/Kconfig
```kconfig
menu "LA32R architecture"
	depends on LA32R

config SYS_ARCH
	default "la32r"

choice
    prompt "Board select"

config TARGET_LA32RSOC_DEMO
    bool "LA32RSoC Demo SoC"

config TARGET_LA32RMEGA_DEMO
    bool "LA32RSoC Demo SoC"

endchoice

config LA32R_L1_CACHE_SHIFT
	int
	default "4"

config SYS_ICACHE_LINE_SIZE
	int
	default "4"
	help
	  The size of L1 Icache lines, if known at compile time.

config SYS_DCACHE_LINE_SIZE
	int
	default "4"
	help
	  The size of L1 Dcache lines, if known at compile time.

menu "OS boot interface"

config LA32R_BOOT_FDT
	bool "Hand over a flattened device tree to Linux kernel"
	default y
	help
	  Enable this option if you want U-Boot to hand over a flattened
	  device tree to the kernel. According to UHI register $a0 will be set
	  to -2 and the FDT address is stored in $a1.
endmenu

config LA32R_RELOCATION_TABLE_SIZE
	hex "Relocation table size"
	range 0x100 0x4000
	default "0x4000"
	---help---
	  A table of relocation data will be appended to the U-Boot binary
	  and parsed in relocate_code() to fix up all offsets in the relocated
	  U-Boot.

	  This option allows the amount of space reserved for the table to be
	  adjusted in a range from 256 up to 64k. The default is 32k and should
	  be ok in most cases. Reduce this value to shrink the size of U-Boot
	  binary.

	  The build will fail and a valid size suggested if this is too small.

	  If unsure, leave at the default value.

source "board/nscscc/Kconfig"

endmenu
```

## arch/mips/mach-trivialmips/Kconfig
```kconfig
menu "TrivialMIPS platforms"
    depends on MACH_TRIVIALMIPS

choice
    prompt "Board select"

config TARGET_TRIVIALMIPS_THINPAD
    bool "Thinpad board 2017"

config TARGET_TRIVIALMIPS_NSCSCC
    bool "NSCSCC board 2019"

config TARGET_MEGASOC_DEMO
    bool "MegaSoC Demo SoC"

endchoice

source "board/thucst/Kconfig"

source "board/nscscc/Kconfig"

endmenu
```

## board/nscscc/Kconfig
```kconfig
if TARGET_TRIVIALMIPS_NSCSCC

config SYS_BOARD
    default "2019"

config SYS_VENDOR
    default "nscscc"

config SYS_CONFIG_NAME
    default "trivialmips_nscscc"

config SYS_TEXT_BASE
    default 0x80000000

endif

if TARGET_MEGASOC_DEMO

config SYS_BOARD
    default "2019"

config SYS_VENDOR
    default "nscscc"

config SYS_CONFIG_NAME
    default "megasoc_demo"

config SYS_TEXT_BASE
    default 0xBC000000

endif

if TARGET_LA32RSOC_DEMO

config SYS_BOARD
    default "2019"

config SYS_VENDOR
    default "nscscc"

config SYS_CONFIG_NAME
    default "megasoc_demo"

config SYS_TEXT_BASE
    default 0xBC000000

endif

if TARGET_LA32RMEGA_DEMO

config SYS_BOARD
    default "2019"

config SYS_VENDOR
    default "nscscc"

config SYS_CONFIG_NAME
    default "megasoc_demo"

config SYS_TEXT_BASE
    default 0xBC000000

endif
```

## configs/la32rmega_defconfig
```kconfig
CONFIG_LA32R=y
CONFIG_SYS_TEXT_BASE=0xBC000000
CONFIG_SYS_MALLOC_F_LEN=0x600
CONFIG_TARGET_LA32RMEGA_DEMO=y
CONFIG_DEBUG_UART_BASE=0x9fe40000
CONFIG_DEBUG_UART_CLOCK=100000000
CONFIG_DEBUG_UART=y
CONFIG_BOOTDELAY=1
CONFIG_USE_BOOTCOMMAND=y
CONFIG_BOOTCOMMAND="fatload mmc 0 0xa2000000 vmlinux;bootelf 0xa2000000 g console=ttyS0,230400 root=/dev/mmcblk0p2 rootfstype=ext4 rw rootwait loglevel=9 uio_pdrv_genirq.of_id=generic-uio"
CONFIG_LOG_DEFAULT_LEVEL=4
CONFIG_HUSH_PARSER=y
CONFIG_SYS_PROMPT="u-boot@LainSoC# "
# CONFIG_CMD_BDI is not set
# CONFIG_CMD_CONSOLE is not set
CONFIG_LA32R_BOOT_FDT=y
CONFIG_CMD_BOOTZ=y
CONFIG_CMD_BOOTMENU=y
# CONFIG_CMD_EXPORTENV is not set
# CONFIG_CMD_IMPORTENV is not set
CONFIG_CMD_MEMTEST=y
CONFIG_CMD_DM=y
CONFIG_CMD_MMC=y
CONFIG_CMD_MMC_SWRITE=y
CONFIG_CMD_MTD=y
CONFIG_CMD_SF=y
CONFIG_CMD_SF_TEST=y
CONFIG_CMD_SPI=y
CONFIG_CMD_DHCP=y
CONFIG_CMD_TFTPSRV=y
# CONFIG_CMD_NFS is not set
CONFIG_CMD_PING=y
CONFIG_CMD_GETTIME=y
CONFIG_CMD_EXT4=y
CONFIG_CMD_EXT4_WRITE=y
CONFIG_CMD_FAT=y
CONFIG_CMD_FS_GENERIC=y
CONFIG_OF_CONTROL=y
CONFIG_OF_EMBED=y
CONFIG_DEFAULT_DEVICE_TREE="la32rmega_demo"
CONFIG_NET_RANDOM_ETHADDR=y
CONFIG_NETCONSOLE=y
CONFIG_DM=y
CONFIG_CLK=y
CONFIG_DM_GPIO=y
CONFIG_MMC=y
CONFIG_DM_MMC=y
CONFIG_MMC_OCSDC=y
# CONFIG_MMC_HW_PARTITIONING is not set
# CONFIG_MMC_TRACE=y
CONFIG_PHYLIB=y
CONFIG_DM_ETH=y
CONFIG_ETHOC=y
CONFIG_MII=y
CONFIG_BAUDRATE=230400
CONFIG_DM_SERIAL=y
CONFIG_DEBUG_UART_ANNOUNCE=y
CONFIG_SYS_NS16550=y
CONFIG_SPI=y
CONFIG_DM_SPI=y
CONFIG_SPI_MEM=y
CONFIG_LOONGSON_SPI=y
CONFIG_USB=y
CONFIG_DM_USB=y
CONFIG_USB_DWC2=y
CONFIG_USB_DWC2_BUFFER_SIZE=8
CONFIG_CMD_DHRYSTONE=y
```

## configs/la32rsoc_defconfig
```kconfig
CONFIG_LA32R=y
CONFIG_SYS_TEXT_BASE=0xbc000000
CONFIG_SYS_MALLOC_F_LEN=0x600
CONFIG_DEBUG_UART_BASE=0x9fe001e0
CONFIG_DEBUG_UART_CLOCK=166666666
CONFIG_DEBUG_UART=y
CONFIG_SD_BOOT=y
CONFIG_BOOTDELAY=3
CONFIG_LOG_DEFAULT_LEVEL=4
CONFIG_DISPLAY_CPUINFO=y
CONFIG_DISPLAY_BOARDINFO=y
CONFIG_DISPLAY_BOARDINFO_LATE=y
CONFIG_HUSH_PARSER=y
CONFIG_SYS_PROMPT="u-boot@LainSoC# "
# CONFIG_CMD_BDI is not set
# CONFIG_CMD_CONSOLE is not set
CONFIG_CMD_BOOTZ=y
CONFIG_CMD_BOOTMENU=y
# CONFIG_CMD_EXPORTENV is not set
# CONFIG_CMD_IMPORTENV is not set
CONFIG_CMD_MEMTEST=y
CONFIG_CMD_DM=y
CONFIG_CMD_MMC=y
CONFIG_CMD_SPI=y
CONFIG_CMD_DHCP=y
CONFIG_CMD_TFTPSRV=y
# CONFIG_CMD_NFS is not set
CONFIG_CMD_PING=y
CONFIG_CMD_GETTIME=y
CONFIG_CMD_EXT4=y
CONFIG_CMD_EXT4_WRITE=y
CONFIG_CMD_FAT=y
CONFIG_CMD_FS_GENERIC=y
CONFIG_OF_CONTROL=y
CONFIG_OF_EMBED=y
CONFIG_DEFAULT_DEVICE_TREE="la32rsoc_demo.dts"
CONFIG_NET_RANDOM_ETHADDR=y
CONFIG_NETCONSOLE=y
CONFIG_DM=y
CONFIG_DM_GPIO=y
CONFIG_MMC=y
CONFIG_DM_MMC=y
CONFIG_MMC_OCSDC=y
# CONFIG_MMC_HW_PARTITIONING is not set
CONFIG_PHYLIB=y
CONFIG_DM_ETH=y
CONFIG_ETHOC=y
CONFIG_MII=y
CONFIG_BAUDRATE=230400
CONFIG_DM_SERIAL=y
CONFIG_DEBUG_UART_ANNOUNCE=y
CONFIG_SYS_NS16550=y
CONFIG_SPI=y
CONFIG_DM_SPI=y
CONFIG_XILINX_SPI=y
CONFIG_CMD_DHRYSTONE=y
```

## configs/megasoc_defconfig
```kconfig
CONFIG_MIPS=y
CONFIG_SYS_TEXT_BASE=0x9FC00000
CONFIG_SYS_MALLOC_F_LEN=0x600
CONFIG_DEBUG_UART_BASE=0xbfe40000
CONFIG_DEBUG_UART_CLOCK=166666666
CONFIG_MACH_TRIVIALMIPS=y
CONFIG_TARGET_MEGASOC_DEMO=y
# CONFIG_MIPS_BOOT_ENV_LEGACY is not set
CONFIG_MIPS_BOOT_FDT=y
CONFIG_DEBUG_UART=y
CONFIG_BOOTDELAY=3
CONFIG_USE_BOOTCOMMAND=y
CONFIG_BOOTCOMMAND="load mmc 0 80100000 boot.scr; source 80100000"
CONFIG_LOG_DEFAULT_LEVEL=4
# CONFIG_DISPLAY_BOARDINFO is not set
CONFIG_HUSH_PARSER=y
CONFIG_SYS_PROMPT="u-boot@MegaSoC# "
# CONFIG_CMD_BDI is not set
# CONFIG_CMD_CONSOLE is not set
CONFIG_CMD_BOOTZ=y
CONFIG_CMD_BOOTMENU=y
# CONFIG_CMD_EXPORTENV is not set
# CONFIG_CMD_IMPORTENV is not set
CONFIG_CMD_MEMTEST=y
CONFIG_CMD_DM=y
CONFIG_CMD_MMC=y
CONFIG_CMD_MMC_SWRITE=y
CONFIG_CMD_MTD=y
CONFIG_CMD_SF=y
CONFIG_CMD_SF_TEST=y
CONFIG_CMD_SPI=y
CONFIG_CMD_DHCP=y
CONFIG_CMD_TFTPSRV=y
# CONFIG_CMD_NFS is not set
CONFIG_CMD_PING=y
CONFIG_CMD_GETTIME=y
CONFIG_CMD_EXT4=y
CONFIG_CMD_EXT4_WRITE=y
CONFIG_CMD_FAT=y
CONFIG_CMD_FS_GENERIC=y
# CONFIG_ISO_PARTITION is not set
CONFIG_OF_EMBED=y
CONFIG_DEFAULT_DEVICE_TREE="megasoc_demo"
CONFIG_NET_RANDOM_ETHADDR=y
CONFIG_NETCONSOLE=y
CONFIG_CLK=y
CONFIG_DM_GPIO=y
CONFIG_MMC=y
CONFIG_DM_MMC=y
CONFIG_MMC_OCSDC=y
# CONFIG_MMC_HW_PARTITIONING is not set
CONFIG_MMC_TRACE=y
CONFIG_MTD=y
CONFIG_MTD_NOR_FLASH=y
CONFIG_MTD_DEVICE=y
CONFIG_FLASH_CFI_DRIVER=y
CONFIG_CFI_FLASH=y
CONFIG_SYS_FLASH_USE_BUFFER_WRITE=y
CONFIG_FLASH_CFI_MTD=y
CONFIG_SYS_FLASH_CFI=y
CONFIG_MTD_SPI_NAND=y
CONFIG_DM_SPI_FLASH=y
CONFIG_SPI_FLASH=y
CONFIG_SF_DEFAULT_SPEED=30000000
CONFIG_SPI_FLASH_BAR=y
CONFIG_SPI_FLASH_MACRONIX=y
CONFIG_SPI_FLASH_SPANSION=y
CONFIG_SPI_FLASH_MTD=y
CONFIG_DM_ETH=y
CONFIG_ETHOC=y
CONFIG_XILINX_EMACLITE=y
CONFIG_BAUDRATE=230400
CONFIG_DEBUG_UART_ANNOUNCE=y
CONFIG_SYS_NS16550=y
# CONFIG_TRIVIALMIPS_SERIAL is not set
CONFIG_SPI=y
CONFIG_DM_SPI=y
CONFIG_LOONGSON_SPI=y
CONFIG_USB=y
CONFIG_DM_USB=y
CONFIG_USB_DWC2=y
CONFIG_USB_DWC2_BUFFER_SIZE=8
CONFIG_CMD_DHRYSTONE=y
```
